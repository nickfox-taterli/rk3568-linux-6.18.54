## Documentation/devicetree/bindings/arm/rockchip/rk3568-headless-pm.yaml
```yaml
# SPDX-License-Identifier: (GPL-2.0-only OR BSD-2-Clause)
%YAML 1.2
---
$id: http://devicetree.org/schemas/arm/rockchip/rk3568-headless-pm.yaml#
$schema: http://devicetree.org/meta-schemas/core.yaml#

title: Local RK3568 BL31 sleep configuration bridge

maintainers:
  - Rockchip Linux <linux-rockchip@lists.infradead.org>

description: |
  Configure the existing BL31 sleep ABI before mainline PSCI system suspend.
  This is a local compatibility binding, not an upstream firmware ABI claim.

properties:
  compatible:
    const: rockchip,rk3568-headless-pm

  rockchip,sleep-mode-config:
    $ref: /schemas/types.yaml#/definitions/uint32
    description: RK3568 firmware sleep-mode bitmask.

  rockchip,wakeup-config:
    $ref: /schemas/types.yaml#/definitions/uint32
    description: RK3568 firmware wake-source bitmask.

  rockchip,sleep-debug-en:
    $ref: /schemas/types.yaml#/definitions/uint32
    enum: [0, 1]
    description: Enable BL31 sleep diagnostics on UART.

required:
  - compatible
  - rockchip,sleep-mode-config
  - rockchip,wakeup-config
  - rockchip,sleep-debug-en

additionalProperties: false
```

## Documentation/devicetree/bindings/media/rockchip,mpp-service.yaml
```yaml
# SPDX-License-Identifier: (GPL-2.0-only OR BSD-2-Clause)
%YAML 1.2
---
$id: http://devicetree.org/schemas/media/rockchip,mpp-service.yaml#
$schema: http://devicetree.org/meta-schemas/core.yaml#

title: Rockchip vendor MPP task queue service

maintainers:
  - Rockchip Linux <linux-rockchip@lists.infradead.org>

description: |
  Local binding for the vendor MPP compatibility driver in drivers/vendor/mpp.
  Codec engines reference this shared task queue and reset group service.

properties:
  compatible:
    const: rockchip,mpp-service

  rockchip,taskqueue-count:
    $ref: /schemas/types.yaml#/definitions/uint32
    minimum: 1
    maximum: 16
    description: Number of independently scheduled codec task queues.

  rockchip,resetgroup-count:
    $ref: /schemas/types.yaml#/definitions/uint32
    minimum: 1
    maximum: 16
    description: Number of codec reset groups.

required:
  - compatible
  - rockchip,taskqueue-count
  - rockchip,resetgroup-count

additionalProperties: false
```

## Documentation/devicetree/bindings/media/rockchip,vendor-mpp.yaml
```yaml
# SPDX-License-Identifier: (GPL-2.0-only OR BSD-2-Clause)
%YAML 1.2
---
$id: http://devicetree.org/schemas/media/rockchip,vendor-mpp.yaml#
$schema: http://devicetree.org/meta-schemas/core.yaml#

title: RK3568 vendor MPP codec engines

maintainers:
  - Rockchip Linux <linux-rockchip@lists.infradead.org>

description: |
  Local binding for the SDK ioctl compatibility engines in drivers/vendor/mpp.
  Each engine uses the shared MPP service for task scheduling and reset groups.

properties:
  compatible:
    enum:
      - rockchip,vpu-decoder-v2
      - rockchip,vpu-encoder-v2
      - rockchip,rkv-decoder-rk3568
      - rockchip,rkv-jpeg-decoder-v1
      - rockchip,rkv-encoder-v1
      - rockchip,rk3568-iep

  reg:
    minItems: 1
    maxItems: 2

  reg-names:
    items:
      - const: regs
      - const: link

  interrupts:
    maxItems: 1

  interrupt-names:
    maxItems: 1

  clocks:
    minItems: 2
    maxItems: 5

  clock-names:
    minItems: 2
    maxItems: 5

  resets:
    minItems: 2
    maxItems: 7

  reset-names:
    minItems: 2
    maxItems: 7

  power-domains:
    maxItems: 1

  iommus:
    maxItems: 1

  rockchip,srv:
    $ref: /schemas/types.yaml#/definitions/phandle
    description: Shared MPP task queue service.

  rockchip,taskqueue-node:
    $ref: /schemas/types.yaml#/definitions/uint32
    maximum: 15
    description: Index of the engine's task queue in the MPP service.

  rockchip,resetgroup-node:
    $ref: /schemas/types.yaml#/definitions/uint32
    maximum: 15
    description: Index of the engine's reset group in the MPP service.

  rockchip,task-capacity:
    $ref: /schemas/types.yaml#/definitions/uint32
    minimum: 1
    description: Maximum simultaneous queued tasks.

  rockchip,normal-rates:
    $ref: /schemas/types.yaml#/definitions/uint32-array
    minItems: 2
    maxItems: 5
    description: Normal operating rates corresponding to the clock list.

  rockchip,advanced-rates:
    $ref: /schemas/types.yaml#/definitions/uint32-array
    minItems: 2
    maxItems: 5
    description: Higher load operating rates corresponding to the clock list.

  rockchip,default-max-load:
    $ref: /schemas/types.yaml#/definitions/uint32
    description: Pixel load threshold for selecting higher operating rates.

  rockchip,disable-auto-freq:
    type: boolean
    description: Keep the initial engine clock rates.

  rockchip,disable-link-mode:
    type: boolean
    description: Use direct submission instead of the decoder hardware link queue.

  operating-points-v2: true

  mpp-supply:
    description: Shared logic supply used for core OPP voltage votes.

  '#cooling-cells':
    const: 2

  rockchip,sram:
    $ref: /schemas/types.yaml#/definitions/phandle
    description: Decoder SRAM resource mapped through the DMA API.

  rockchip,rcb-size:
    $ref: /schemas/types.yaml#/definitions/uint32
    description: Total per-task RCB budget including coherent DDR fallback.

  rockchip,rcb-min-width:
    $ref: /schemas/types.yaml#/definitions/uint32
    description: Minimum decoded width for using SRAM RCBs.

required:
  - compatible
  - reg
  - interrupts
  - clocks
  - clock-names
  - resets
  - reset-names
  - power-domains
  - iommus
  - rockchip,srv
  - rockchip,taskqueue-node
  - rockchip,resetgroup-node

additionalProperties: false
```

## Documentation/devicetree/bindings/media/rockchip,vendor-rga2.yaml
```yaml
# SPDX-License-Identifier: (GPL-2.0-only OR BSD-2-Clause)
%YAML 1.2
---
$id: http://devicetree.org/schemas/media/rockchip,vendor-rga2.yaml#
$schema: http://devicetree.org/meta-schemas/core.yaml#

title: RK3568 vendor RGA2 compatibility engine

maintainers:
  - Rockchip Linux <linux-rockchip@lists.infradead.org>

description: |
  Local binding for the SDK ioctl driver in drivers/vendor/rga3.

properties:
  compatible:
    const: rockchip,rga2

  reg:
    maxItems: 1

  interrupts:
    maxItems: 1

  clocks:
    maxItems: 3

  clock-names:
    items:
      - const: aclk_rga
      - const: hclk_rga
      - const: clk_rga

  resets:
    maxItems: 3

  reset-names:
    items:
      - const: core
      - const: axi
      - const: ahb

  power-domains:
    maxItems: 1

required:
  - compatible
  - reg
  - interrupts
  - clocks
  - clock-names
  - resets
  - reset-names
  - power-domains

additionalProperties: false
```

## Documentation/devicetree/bindings/memory-controllers/rockchip,rk3568-headless-dmc.yaml
```yaml
# SPDX-License-Identifier: (GPL-2.0-only OR BSD-2-Clause)
%YAML 1.2
---
$id: http://devicetree.org/schemas/memory-controllers/rockchip,rk3568-headless-dmc.yaml#
$schema: http://devicetree.org/meta-schemas/core.yaml#

title: Local RK3568 headless BL31 DDR scaling controller

maintainers:
  - Rockchip Linux <linux-rockchip@lists.infradead.org>

description: |
  Local compatibility driver using mainline devfreq and DFI events with the
  RK3568 BL31 DDR mailbox ABI. OPP rates are discovered from trained firmware
  FSPs. The firmware shared pages must be outside allocatable System RAM.

properties:
  compatible:
    const: rockchip,rk3568-headless-dmc

  clocks:
    maxItems: 1

  clock-names:
    const: dmc

  devfreq-events:
    $ref: /schemas/types.yaml#/definitions/phandle-array
    maxItems: 1
    description: Rockchip DFI bandwidth event counter.

  interrupts:
    maxItems: 1
    description: DDR MCU completion interrupt.

required:
  - compatible
  - clocks
  - clock-names
  - devfreq-events
  - interrupts

additionalProperties: false
```

## Documentation/devicetree/bindings/misc/rockchip,vendor-rknpu.yaml
```yaml
# SPDX-License-Identifier: (GPL-2.0-only OR BSD-2-Clause)
%YAML 1.2
---
$id: http://devicetree.org/schemas/misc/rockchip,vendor-rknpu.yaml#
$schema: http://devicetree.org/meta-schemas/core.yaml#

title: RK3568 vendor RKNPU compatibility engine

maintainers:
  - Rockchip Linux <linux-rockchip@lists.infradead.org>

description: |
  Local binding for drivers/vendor/rknpu and the SDK RKNN runtime ABI.
  Optional mainline OPP, devfreq, OTP grading and thermal cooling are supported.

properties:
  compatible:
    items:
      - const: rockchip,rk3568-rknpu
      - const: rockchip,rknpu

  reg:
    maxItems: 1

  interrupts:
    maxItems: 1

  clocks:
    maxItems: 4

  clock-names:
    items:
      - const: scmi_clk
      - const: clk
      - const: aclk
      - const: hclk

  resets:
    maxItems: 2

  reset-names:
    items:
      - const: srst_a
      - const: srst_h

  power-domains:
    maxItems: 1

  iommus:
    maxItems: 1

  rknpu-supply:
    description: NPU core supply.

  operating-points-v2: true

  nvmem-cells:
    maxItems: 2

  nvmem-cell-names:
    items:
      - const: npu-grade
      - const: npu-grade-remark

  '#cooling-cells':
    const: 2

required:
  - compatible
  - reg
  - interrupts
  - clocks
  - clock-names
  - resets
  - reset-names
  - power-domains
  - iommus

additionalProperties: false
```

## drivers/vendor/Kconfig
```kconfig
# SPDX-License-Identifier: GPL-2.0

menu "Rockchip vendor compatibility drivers"

source "drivers/vendor/dma_heap/Kconfig"
source "drivers/vendor/rknpu/Kconfig"
source "drivers/vendor/mpp/Kconfig"

source "drivers/vendor/rga/Kconfig"

endmenu
```

## drivers/vendor/mpp/Kconfig
```kconfig
# SPDX-License-Identifier: GPL-2.0

config ROCKCHIP_VENDOR_MPP
	tristate "Rockchip SDK MPP codec compatibility"
	depends on ARCH_ROCKCHIP && ROCKCHIP_IOMMU && DMA_SHARED_BUFFER
	depends on VIDEO_HANTRO_ROCKCHIP = n && VIDEO_ROCKCHIP_VDEC = n
	help
	  SDK MPP service for RK3568 video and JPEG encode/decode.
	  Do not enable the mainline Rockchip codec drivers in this image.

config ROCKCHIP_MPP_RKVDEC2
	bool "RK3568 RKVDEC2 decoder"
	depends on ROCKCHIP_VENDOR_MPP
	default y

config ROCKCHIP_MPP_VDPU2
	bool "RK3568 VDPU2 MPEG-2/MPEG-4/H.263/VP8 decoder"
	depends on ROCKCHIP_VENDOR_MPP
	default y

config ROCKCHIP_MPP_VEPU2
	bool "RK3568 VEPU2 JPEG encoder"
	depends on ROCKCHIP_VENDOR_MPP
	default y

config ROCKCHIP_MPP_RKVENC
	bool "RK3568 RKVENC H.264/H.265 encoder"
	depends on ROCKCHIP_VENDOR_MPP
	default y

config ROCKCHIP_MPP_JPGDEC
	bool "RK3568 JPEG decoder"
	depends on ROCKCHIP_VENDOR_MPP
	default y

config ROCKCHIP_MPP_PROC_FS
	bool "MPP diagnostics in procfs"
	depends on ROCKCHIP_VENDOR_MPP && PROC_FS
	default y
```

## drivers/vendor/rknpu/Kconfig
```kconfig
# SPDX-License-Identifier: GPL-2.0
menu "RKNPU"
	depends on ARCH_ROCKCHIP

config ROCKCHIP_RKNPU
	tristate "ROCKCHIP_RKNPU"
	depends on DMABUF_HEAPS_ROCKCHIP_CMA_HEAP && IOMMU_SUPPORT
	help
	  rknpu module.

if ROCKCHIP_RKNPU

config ROCKCHIP_RKNPU_DEBUG_FS
	bool "RKNPU debugfs"
	depends on DEBUG_FS
	default y
	help
	  Enable debugfs to debug RKNPU usage.

config ROCKCHIP_RKNPU_OPP
	bool "Mainline OPP/devfreq control for RKNPU"
	depends on PM_OPP && PM_DEVFREQ && COMMON_CLK && REGULATOR
	select DEVFREQ_GOV_SIMPLE_ONDEMAND
	help
	  Use mainline OPP, devfreq load control and thermal cooling with the
	  NPU SCMI clock and rknpu regulator. Debugfs freq adds manual QoS limits;
	  writing zero releases them. Thermal maximum limits remain effective.

config ROCKCHIP_RKNPU_PROC_FS
	bool "RKNPU procfs"
	depends on PROC_FS
	help
	  Enable procfs to debug RKNPU usage.

config ROCKCHIP_RKNPU_FENCE
	bool "RKNPU fence"
	depends on SYNC_FILE
	help
	  Enable fence support for RKNPU.

config ROCKCHIP_RKNPU_SRAM
	bool "RKNPU SRAM"
	depends on NO_GKI
	help
	  Enable RKNPU SRAM support

config ROCKCHIP_RKNPU_DRM_GEM
	bool
	depends on n

config ROCKCHIP_RKNPU_DMA_HEAP
	bool
	default y
	depends on DMABUF_HEAPS_ROCKCHIP_CMA_HEAP

endif

endmenu
```
